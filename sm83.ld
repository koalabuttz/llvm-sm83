/* sm83.ld — Game Boy (SM83) linker script.
 *
 * Supports ROM-only (32 KB), MBC1 (up to 256 KB), MBC3 (up to 2 MB), and
 * MBC5 (up to 2 MB via banks 1..127; bit-8 banks 128..511 require linker
 * script expansion). Bank 0 is always mapped at $0000–$3FFF. Banks 1..127
 * can hold data and — as of Round 7 — far-callable functions, paged into
 * $4000–$7FFF by writing the bank number to $2000
 * (see runtime/gb.h:BANK_SWITCH).
 *
 * This layout follows the GBDK convention: most code lives in bank 0 so a
 * BANK_SWITCH can never page out the currently-executing function. Round 7
 * adds compiler-emitted far calls: a function in .romx.bankN can be called
 * from bank 0 via an inline BANK_SWITCH(N) / CALL / BANK_SWITCH(1) sequence
 * generated by SM83ISelLowering::LowerCall when the callee's section is
 * .romx.bankN. Bank-to-bank (callee→callee) far calls are not yet
 * supported — callers must live in bank 0.
 *
 * Memory map:
 *   $0000–$003F  RST vectors (8 × 8 bytes)
 *   $0040–$0067  Interrupt service routine dispatch (JP trampolines)
 *   $0100–$0103  Entry point: NOP; JP $0150  (written by make-gb-rom.py)
 *   $0104–$014F  Nintendo logo + ROM header  (written by make-gb-rom.py)
 *   $0150–$3FFF  All code and read-only data (bank 0, fixed)
 *   $4000–$7FFF  Data bank window (bank 1 default, any bank via BANK_SWITCH)
 *   $C000–$DFFF  WRAM (8 KB)
 *   $FF80–$FFFE  HRAM (127 bytes)
 *
 * Usage:
 *   ld.lld --no-check-sections -T sm83.ld foo.o runtime.o -o foo.elf
 *   python3 make-gb-rom.py foo.elf -o foo.gb                 # 32 KB ROM-only
 *   python3 make-gb-rom.py foo.elf -o foo.gb --mbc1 --rom-banks 16
 *
 * The --no-check-sections flag is required because all banks share VMA
 * $4000-$7FFF (that's the whole point of MBC overlay banking).
 */

OUTPUT_ARCH(sm83)
ENTRY(_start)

MEMORY {
    ROM0 (rx)  : ORIGIN = 0x0000, LENGTH = 0x4000  /* 16 KB bank 0 (fixed) */
    ROMX (rx)  : ORIGIN = 0x4000, LENGTH = 0x4000  /* 16 KB bank window */
    WRAM (rw)  : ORIGIN = 0xC000, LENGTH = 0x2000  /* 8 KB Work RAM */
    HRAM (rw)  : ORIGIN = 0xFF80, LENGTH = 0x007F  /* 127 bytes High RAM */
}

SECTIONS {
    /* RST vectors at $0000–$003F. */
    .vectors 0x0000 : {
        KEEP(*(.vectors))
        . = 0x0040;
    } > ROM0

    /*
     * Interrupt vector dispatch table at $0040-$0067.
     *
     * Each 8-byte slot holds a 3-byte `JP <handler>` trampoline. Handler
     * bodies live in .text (KEEP'd below). Undefined handlers default to
     * the RETI stub via the PROVIDE lines further down.
     */
    .isr_dispatch 0x0040 : {
        BYTE(0xC3); SHORT(vblank_isr);
        BYTE(0); BYTE(0); BYTE(0); BYTE(0); BYTE(0);
        BYTE(0xC3); SHORT(lcd_isr);
        BYTE(0); BYTE(0); BYTE(0); BYTE(0); BYTE(0);
        BYTE(0xC3); SHORT(timer_isr);
        BYTE(0); BYTE(0); BYTE(0); BYTE(0); BYTE(0);
        BYTE(0xC3); SHORT(serial_isr);
        BYTE(0); BYTE(0); BYTE(0); BYTE(0); BYTE(0);
        BYTE(0xC3); SHORT(joypad_isr);
        BYTE(0); BYTE(0); BYTE(0); BYTE(0); BYTE(0);
    } > ROM0

    /* Header placeholder; make-gb-rom.py writes $0100-$014F post-link. */
    .header 0x0100 (NOLOAD) : {
        . = 0x0150;
    } > ROM0

    /*
     * All program code and read-only data lives in bank 0.
     *
     * A function stays at the same ROM address regardless of which bank
     * is currently paged in at $4000 — so BANK_SWITCH(N) paging bank N
     * into the window cannot orphan the currently-executing code.
     *
     * If a program doesn't fit in bank 0's 16 KB, the user must either
     * move rarely-called code into a high bank via .romx.bankN AND never
     * BANK_SWITCH away from it while it's running (Round 5 scope), or
     * use a far-call trampoline (Round 6).
     */
    .text 0x0150 : {
        KEEP(*(.text._start))
        KEEP(*(.text.icall_hl))    /* jp hl trampoline — __sm83_icall_hl */
        KEEP(*(.isr.vblank))
        KEEP(*(.isr.lcd))
        KEEP(*(.isr.timer))
        KEEP(*(.isr.serial))
        KEEP(*(.isr.joypad))
        *(.text*)
        *(.rodata*)
        *(.rodata)
        . = ALIGN(2);
        _default_isr_stub = .;
        BYTE(0xD9);                /* RETI — one-byte default ISR body */
        . = ALIGN(2);
        _rom0_end = .;
    } > ROM0
    ASSERT(_rom0_end <= 0x4000,
           "ROM0 overflow: code + rodata exceeds 16 KB bank 0")

    PROVIDE(vblank_isr = _default_isr_stub);
    PROVIDE(lcd_isr    = _default_isr_stub);
    PROVIDE(timer_isr  = _default_isr_stub);
    PROVIDE(serial_isr = _default_isr_stub);
    PROVIDE(joypad_isr = _default_isr_stub);

    /*
     * Banks 1..127: opt-in data/code banks via __attribute__((section(".romx.bankN"))).
     *
     * All banks share VMA $4000-$7FFF because the MBC overlays them into
     * the same address window. They have distinct LMAs at N * $4000 in
     * the ROM file so make-gb-rom.py lays them out at the right cartridge
     * offsets. Requires ld.lld --no-check-sections.
     *
     * For data: users must BANK_SWITCH(N) to page in bank N before reading
     * its contents through $4000-$7FFF. Bank 1 is the hardware default at
     * reset, but crt0 explicitly writes 1 to $2000 for determinism.
     *
     * For functions: the compiler emits an inline BANK_SWITCH(N) / CALL /
     * BANK_SWITCH(1) sequence when LowerCall sees a callee in .romx.bankN,
     * so user code calls far functions as if they were near.
     *
     * 511 sections × 16 KB = 8 MB — covers MBC3's full address space and
     * MBC5's full 9-bit bank register range. Banks 1..127 are selected by
     * writing $2000; banks 128..511 additionally need the upper bit written
     * to $3000 (LowerCall emits both stores when the callee is in bank
     * ≥ 256).
     */
    .romx.bank1  0x4000 : AT(0x04000) { *(.romx.bank1*)  . = ALIGN(2); } > ROMX
    .romx.bank2  0x4000 : AT(0x08000) { *(.romx.bank2*)  . = ALIGN(2); } > ROMX
    .romx.bank3  0x4000 : AT(0x0C000) { *(.romx.bank3*)  . = ALIGN(2); } > ROMX
    .romx.bank4  0x4000 : AT(0x10000) { *(.romx.bank4*)  . = ALIGN(2); } > ROMX
    .romx.bank5  0x4000 : AT(0x14000) { *(.romx.bank5*)  . = ALIGN(2); } > ROMX
    .romx.bank6  0x4000 : AT(0x18000) { *(.romx.bank6*)  . = ALIGN(2); } > ROMX
    .romx.bank7  0x4000 : AT(0x1C000) { *(.romx.bank7*)  . = ALIGN(2); } > ROMX
    .romx.bank8  0x4000 : AT(0x20000) { *(.romx.bank8*)  . = ALIGN(2); } > ROMX
    .romx.bank9  0x4000 : AT(0x24000) { *(.romx.bank9*)  . = ALIGN(2); } > ROMX
    .romx.bank10 0x4000 : AT(0x28000) { *(.romx.bank10*) . = ALIGN(2); } > ROMX
    .romx.bank11 0x4000 : AT(0x2C000) { *(.romx.bank11*) . = ALIGN(2); } > ROMX
    .romx.bank12 0x4000 : AT(0x30000) { *(.romx.bank12*) . = ALIGN(2); } > ROMX
    .romx.bank13 0x4000 : AT(0x34000) { *(.romx.bank13*) . = ALIGN(2); } > ROMX
    .romx.bank14 0x4000 : AT(0x38000) { *(.romx.bank14*) . = ALIGN(2); } > ROMX
    .romx.bank15 0x4000 : AT(0x3C000) { *(.romx.bank15*) . = ALIGN(2); } > ROMX
    .romx.bank16 0x4000 : AT(0x40000) { *(.romx.bank16*) . = ALIGN(2); } > ROMX
    .romx.bank17 0x4000 : AT(0x44000) { *(.romx.bank17*) . = ALIGN(2); } > ROMX
    .romx.bank18 0x4000 : AT(0x48000) { *(.romx.bank18*) . = ALIGN(2); } > ROMX
    .romx.bank19 0x4000 : AT(0x4C000) { *(.romx.bank19*) . = ALIGN(2); } > ROMX
    .romx.bank20 0x4000 : AT(0x50000) { *(.romx.bank20*) . = ALIGN(2); } > ROMX
    .romx.bank21 0x4000 : AT(0x54000) { *(.romx.bank21*) . = ALIGN(2); } > ROMX
    .romx.bank22 0x4000 : AT(0x58000) { *(.romx.bank22*) . = ALIGN(2); } > ROMX
    .romx.bank23 0x4000 : AT(0x5C000) { *(.romx.bank23*) . = ALIGN(2); } > ROMX
    .romx.bank24 0x4000 : AT(0x60000) { *(.romx.bank24*) . = ALIGN(2); } > ROMX
    .romx.bank25 0x4000 : AT(0x64000) { *(.romx.bank25*) . = ALIGN(2); } > ROMX
    .romx.bank26 0x4000 : AT(0x68000) { *(.romx.bank26*) . = ALIGN(2); } > ROMX
    .romx.bank27 0x4000 : AT(0x6C000) { *(.romx.bank27*) . = ALIGN(2); } > ROMX
    .romx.bank28 0x4000 : AT(0x70000) { *(.romx.bank28*) . = ALIGN(2); } > ROMX
    .romx.bank29 0x4000 : AT(0x74000) { *(.romx.bank29*) . = ALIGN(2); } > ROMX
    .romx.bank30 0x4000 : AT(0x78000) { *(.romx.bank30*) . = ALIGN(2); } > ROMX
    .romx.bank31 0x4000 : AT(0x7C000) { *(.romx.bank31*) . = ALIGN(2); } > ROMX
    .romx.bank32 0x4000 : AT(0x80000) { *(.romx.bank32*) . = ALIGN(2); } > ROMX
    .romx.bank33 0x4000 : AT(0x84000) { *(.romx.bank33*) . = ALIGN(2); } > ROMX
    .romx.bank34 0x4000 : AT(0x88000) { *(.romx.bank34*) . = ALIGN(2); } > ROMX
    .romx.bank35 0x4000 : AT(0x8C000) { *(.romx.bank35*) . = ALIGN(2); } > ROMX
    .romx.bank36 0x4000 : AT(0x90000) { *(.romx.bank36*) . = ALIGN(2); } > ROMX
    .romx.bank37 0x4000 : AT(0x94000) { *(.romx.bank37*) . = ALIGN(2); } > ROMX
    .romx.bank38 0x4000 : AT(0x98000) { *(.romx.bank38*) . = ALIGN(2); } > ROMX
    .romx.bank39 0x4000 : AT(0x9C000) { *(.romx.bank39*) . = ALIGN(2); } > ROMX
    .romx.bank40 0x4000 : AT(0xA0000) { *(.romx.bank40*) . = ALIGN(2); } > ROMX
    .romx.bank41 0x4000 : AT(0xA4000) { *(.romx.bank41*) . = ALIGN(2); } > ROMX
    .romx.bank42 0x4000 : AT(0xA8000) { *(.romx.bank42*) . = ALIGN(2); } > ROMX
    .romx.bank43 0x4000 : AT(0xAC000) { *(.romx.bank43*) . = ALIGN(2); } > ROMX
    .romx.bank44 0x4000 : AT(0xB0000) { *(.romx.bank44*) . = ALIGN(2); } > ROMX
    .romx.bank45 0x4000 : AT(0xB4000) { *(.romx.bank45*) . = ALIGN(2); } > ROMX
    .romx.bank46 0x4000 : AT(0xB8000) { *(.romx.bank46*) . = ALIGN(2); } > ROMX
    .romx.bank47 0x4000 : AT(0xBC000) { *(.romx.bank47*) . = ALIGN(2); } > ROMX
    .romx.bank48 0x4000 : AT(0xC0000) { *(.romx.bank48*) . = ALIGN(2); } > ROMX
    .romx.bank49 0x4000 : AT(0xC4000) { *(.romx.bank49*) . = ALIGN(2); } > ROMX
    .romx.bank50 0x4000 : AT(0xC8000) { *(.romx.bank50*) . = ALIGN(2); } > ROMX
    .romx.bank51 0x4000 : AT(0xCC000) { *(.romx.bank51*) . = ALIGN(2); } > ROMX
    .romx.bank52 0x4000 : AT(0xD0000) { *(.romx.bank52*) . = ALIGN(2); } > ROMX
    .romx.bank53 0x4000 : AT(0xD4000) { *(.romx.bank53*) . = ALIGN(2); } > ROMX
    .romx.bank54 0x4000 : AT(0xD8000) { *(.romx.bank54*) . = ALIGN(2); } > ROMX
    .romx.bank55 0x4000 : AT(0xDC000) { *(.romx.bank55*) . = ALIGN(2); } > ROMX
    .romx.bank56 0x4000 : AT(0xE0000) { *(.romx.bank56*) . = ALIGN(2); } > ROMX
    .romx.bank57 0x4000 : AT(0xE4000) { *(.romx.bank57*) . = ALIGN(2); } > ROMX
    .romx.bank58 0x4000 : AT(0xE8000) { *(.romx.bank58*) . = ALIGN(2); } > ROMX
    .romx.bank59 0x4000 : AT(0xEC000) { *(.romx.bank59*) . = ALIGN(2); } > ROMX
    .romx.bank60 0x4000 : AT(0xF0000) { *(.romx.bank60*) . = ALIGN(2); } > ROMX
    .romx.bank61 0x4000 : AT(0xF4000) { *(.romx.bank61*) . = ALIGN(2); } > ROMX
    .romx.bank62 0x4000 : AT(0xF8000) { *(.romx.bank62*) . = ALIGN(2); } > ROMX
    .romx.bank63 0x4000 : AT(0xFC000) { *(.romx.bank63*) . = ALIGN(2); } > ROMX
    .romx.bank64 0x4000 : AT(0x100000) { *(.romx.bank64*) . = ALIGN(2); } > ROMX
    .romx.bank65 0x4000 : AT(0x104000) { *(.romx.bank65*) . = ALIGN(2); } > ROMX
    .romx.bank66 0x4000 : AT(0x108000) { *(.romx.bank66*) . = ALIGN(2); } > ROMX
    .romx.bank67 0x4000 : AT(0x10C000) { *(.romx.bank67*) . = ALIGN(2); } > ROMX
    .romx.bank68 0x4000 : AT(0x110000) { *(.romx.bank68*) . = ALIGN(2); } > ROMX
    .romx.bank69 0x4000 : AT(0x114000) { *(.romx.bank69*) . = ALIGN(2); } > ROMX
    .romx.bank70 0x4000 : AT(0x118000) { *(.romx.bank70*) . = ALIGN(2); } > ROMX
    .romx.bank71 0x4000 : AT(0x11C000) { *(.romx.bank71*) . = ALIGN(2); } > ROMX
    .romx.bank72 0x4000 : AT(0x120000) { *(.romx.bank72*) . = ALIGN(2); } > ROMX
    .romx.bank73 0x4000 : AT(0x124000) { *(.romx.bank73*) . = ALIGN(2); } > ROMX
    .romx.bank74 0x4000 : AT(0x128000) { *(.romx.bank74*) . = ALIGN(2); } > ROMX
    .romx.bank75 0x4000 : AT(0x12C000) { *(.romx.bank75*) . = ALIGN(2); } > ROMX
    .romx.bank76 0x4000 : AT(0x130000) { *(.romx.bank76*) . = ALIGN(2); } > ROMX
    .romx.bank77 0x4000 : AT(0x134000) { *(.romx.bank77*) . = ALIGN(2); } > ROMX
    .romx.bank78 0x4000 : AT(0x138000) { *(.romx.bank78*) . = ALIGN(2); } > ROMX
    .romx.bank79 0x4000 : AT(0x13C000) { *(.romx.bank79*) . = ALIGN(2); } > ROMX
    .romx.bank80 0x4000 : AT(0x140000) { *(.romx.bank80*) . = ALIGN(2); } > ROMX
    .romx.bank81 0x4000 : AT(0x144000) { *(.romx.bank81*) . = ALIGN(2); } > ROMX
    .romx.bank82 0x4000 : AT(0x148000) { *(.romx.bank82*) . = ALIGN(2); } > ROMX
    .romx.bank83 0x4000 : AT(0x14C000) { *(.romx.bank83*) . = ALIGN(2); } > ROMX
    .romx.bank84 0x4000 : AT(0x150000) { *(.romx.bank84*) . = ALIGN(2); } > ROMX
    .romx.bank85 0x4000 : AT(0x154000) { *(.romx.bank85*) . = ALIGN(2); } > ROMX
    .romx.bank86 0x4000 : AT(0x158000) { *(.romx.bank86*) . = ALIGN(2); } > ROMX
    .romx.bank87 0x4000 : AT(0x15C000) { *(.romx.bank87*) . = ALIGN(2); } > ROMX
    .romx.bank88 0x4000 : AT(0x160000) { *(.romx.bank88*) . = ALIGN(2); } > ROMX
    .romx.bank89 0x4000 : AT(0x164000) { *(.romx.bank89*) . = ALIGN(2); } > ROMX
    .romx.bank90 0x4000 : AT(0x168000) { *(.romx.bank90*) . = ALIGN(2); } > ROMX
    .romx.bank91 0x4000 : AT(0x16C000) { *(.romx.bank91*) . = ALIGN(2); } > ROMX
    .romx.bank92 0x4000 : AT(0x170000) { *(.romx.bank92*) . = ALIGN(2); } > ROMX
    .romx.bank93 0x4000 : AT(0x174000) { *(.romx.bank93*) . = ALIGN(2); } > ROMX
    .romx.bank94 0x4000 : AT(0x178000) { *(.romx.bank94*) . = ALIGN(2); } > ROMX
    .romx.bank95 0x4000 : AT(0x17C000) { *(.romx.bank95*) . = ALIGN(2); } > ROMX
    .romx.bank96 0x4000 : AT(0x180000) { *(.romx.bank96*) . = ALIGN(2); } > ROMX
    .romx.bank97 0x4000 : AT(0x184000) { *(.romx.bank97*) . = ALIGN(2); } > ROMX
    .romx.bank98 0x4000 : AT(0x188000) { *(.romx.bank98*) . = ALIGN(2); } > ROMX
    .romx.bank99 0x4000 : AT(0x18C000) { *(.romx.bank99*) . = ALIGN(2); } > ROMX
    .romx.bank100 0x4000 : AT(0x190000) { *(.romx.bank100*) . = ALIGN(2); } > ROMX
    .romx.bank101 0x4000 : AT(0x194000) { *(.romx.bank101*) . = ALIGN(2); } > ROMX
    .romx.bank102 0x4000 : AT(0x198000) { *(.romx.bank102*) . = ALIGN(2); } > ROMX
    .romx.bank103 0x4000 : AT(0x19C000) { *(.romx.bank103*) . = ALIGN(2); } > ROMX
    .romx.bank104 0x4000 : AT(0x1A0000) { *(.romx.bank104*) . = ALIGN(2); } > ROMX
    .romx.bank105 0x4000 : AT(0x1A4000) { *(.romx.bank105*) . = ALIGN(2); } > ROMX
    .romx.bank106 0x4000 : AT(0x1A8000) { *(.romx.bank106*) . = ALIGN(2); } > ROMX
    .romx.bank107 0x4000 : AT(0x1AC000) { *(.romx.bank107*) . = ALIGN(2); } > ROMX
    .romx.bank108 0x4000 : AT(0x1B0000) { *(.romx.bank108*) . = ALIGN(2); } > ROMX
    .romx.bank109 0x4000 : AT(0x1B4000) { *(.romx.bank109*) . = ALIGN(2); } > ROMX
    .romx.bank110 0x4000 : AT(0x1B8000) { *(.romx.bank110*) . = ALIGN(2); } > ROMX
    .romx.bank111 0x4000 : AT(0x1BC000) { *(.romx.bank111*) . = ALIGN(2); } > ROMX
    .romx.bank112 0x4000 : AT(0x1C0000) { *(.romx.bank112*) . = ALIGN(2); } > ROMX
    .romx.bank113 0x4000 : AT(0x1C4000) { *(.romx.bank113*) . = ALIGN(2); } > ROMX
    .romx.bank114 0x4000 : AT(0x1C8000) { *(.romx.bank114*) . = ALIGN(2); } > ROMX
    .romx.bank115 0x4000 : AT(0x1CC000) { *(.romx.bank115*) . = ALIGN(2); } > ROMX
    .romx.bank116 0x4000 : AT(0x1D0000) { *(.romx.bank116*) . = ALIGN(2); } > ROMX
    .romx.bank117 0x4000 : AT(0x1D4000) { *(.romx.bank117*) . = ALIGN(2); } > ROMX
    .romx.bank118 0x4000 : AT(0x1D8000) { *(.romx.bank118*) . = ALIGN(2); } > ROMX
    .romx.bank119 0x4000 : AT(0x1DC000) { *(.romx.bank119*) . = ALIGN(2); } > ROMX
    .romx.bank120 0x4000 : AT(0x1E0000) { *(.romx.bank120*) . = ALIGN(2); } > ROMX
    .romx.bank121 0x4000 : AT(0x1E4000) { *(.romx.bank121*) . = ALIGN(2); } > ROMX
    .romx.bank122 0x4000 : AT(0x1E8000) { *(.romx.bank122*) . = ALIGN(2); } > ROMX
    .romx.bank123 0x4000 : AT(0x1EC000) { *(.romx.bank123*) . = ALIGN(2); } > ROMX
    .romx.bank124 0x4000 : AT(0x1F0000) { *(.romx.bank124*) . = ALIGN(2); } > ROMX
    .romx.bank125 0x4000 : AT(0x1F4000) { *(.romx.bank125*) . = ALIGN(2); } > ROMX
    .romx.bank126 0x4000 : AT(0x1F8000) { *(.romx.bank126*) . = ALIGN(2); } > ROMX
    .romx.bank127 0x4000 : AT(0x1FC000) { *(.romx.bank127*) . = ALIGN(2); } > ROMX
    .romx.bank128 0x4000 : AT(0x200000) { *(.romx.bank128*) . = ALIGN(2); } > ROMX
    .romx.bank129 0x4000 : AT(0x204000) { *(.romx.bank129*) . = ALIGN(2); } > ROMX
    .romx.bank130 0x4000 : AT(0x208000) { *(.romx.bank130*) . = ALIGN(2); } > ROMX
    .romx.bank131 0x4000 : AT(0x20C000) { *(.romx.bank131*) . = ALIGN(2); } > ROMX
    .romx.bank132 0x4000 : AT(0x210000) { *(.romx.bank132*) . = ALIGN(2); } > ROMX
    .romx.bank133 0x4000 : AT(0x214000) { *(.romx.bank133*) . = ALIGN(2); } > ROMX
    .romx.bank134 0x4000 : AT(0x218000) { *(.romx.bank134*) . = ALIGN(2); } > ROMX
    .romx.bank135 0x4000 : AT(0x21C000) { *(.romx.bank135*) . = ALIGN(2); } > ROMX
    .romx.bank136 0x4000 : AT(0x220000) { *(.romx.bank136*) . = ALIGN(2); } > ROMX
    .romx.bank137 0x4000 : AT(0x224000) { *(.romx.bank137*) . = ALIGN(2); } > ROMX
    .romx.bank138 0x4000 : AT(0x228000) { *(.romx.bank138*) . = ALIGN(2); } > ROMX
    .romx.bank139 0x4000 : AT(0x22C000) { *(.romx.bank139*) . = ALIGN(2); } > ROMX
    .romx.bank140 0x4000 : AT(0x230000) { *(.romx.bank140*) . = ALIGN(2); } > ROMX
    .romx.bank141 0x4000 : AT(0x234000) { *(.romx.bank141*) . = ALIGN(2); } > ROMX
    .romx.bank142 0x4000 : AT(0x238000) { *(.romx.bank142*) . = ALIGN(2); } > ROMX
    .romx.bank143 0x4000 : AT(0x23C000) { *(.romx.bank143*) . = ALIGN(2); } > ROMX
    .romx.bank144 0x4000 : AT(0x240000) { *(.romx.bank144*) . = ALIGN(2); } > ROMX
    .romx.bank145 0x4000 : AT(0x244000) { *(.romx.bank145*) . = ALIGN(2); } > ROMX
    .romx.bank146 0x4000 : AT(0x248000) { *(.romx.bank146*) . = ALIGN(2); } > ROMX
    .romx.bank147 0x4000 : AT(0x24C000) { *(.romx.bank147*) . = ALIGN(2); } > ROMX
    .romx.bank148 0x4000 : AT(0x250000) { *(.romx.bank148*) . = ALIGN(2); } > ROMX
    .romx.bank149 0x4000 : AT(0x254000) { *(.romx.bank149*) . = ALIGN(2); } > ROMX
    .romx.bank150 0x4000 : AT(0x258000) { *(.romx.bank150*) . = ALIGN(2); } > ROMX
    .romx.bank151 0x4000 : AT(0x25C000) { *(.romx.bank151*) . = ALIGN(2); } > ROMX
    .romx.bank152 0x4000 : AT(0x260000) { *(.romx.bank152*) . = ALIGN(2); } > ROMX
    .romx.bank153 0x4000 : AT(0x264000) { *(.romx.bank153*) . = ALIGN(2); } > ROMX
    .romx.bank154 0x4000 : AT(0x268000) { *(.romx.bank154*) . = ALIGN(2); } > ROMX
    .romx.bank155 0x4000 : AT(0x26C000) { *(.romx.bank155*) . = ALIGN(2); } > ROMX
    .romx.bank156 0x4000 : AT(0x270000) { *(.romx.bank156*) . = ALIGN(2); } > ROMX
    .romx.bank157 0x4000 : AT(0x274000) { *(.romx.bank157*) . = ALIGN(2); } > ROMX
    .romx.bank158 0x4000 : AT(0x278000) { *(.romx.bank158*) . = ALIGN(2); } > ROMX
    .romx.bank159 0x4000 : AT(0x27C000) { *(.romx.bank159*) . = ALIGN(2); } > ROMX
    .romx.bank160 0x4000 : AT(0x280000) { *(.romx.bank160*) . = ALIGN(2); } > ROMX
    .romx.bank161 0x4000 : AT(0x284000) { *(.romx.bank161*) . = ALIGN(2); } > ROMX
    .romx.bank162 0x4000 : AT(0x288000) { *(.romx.bank162*) . = ALIGN(2); } > ROMX
    .romx.bank163 0x4000 : AT(0x28C000) { *(.romx.bank163*) . = ALIGN(2); } > ROMX
    .romx.bank164 0x4000 : AT(0x290000) { *(.romx.bank164*) . = ALIGN(2); } > ROMX
    .romx.bank165 0x4000 : AT(0x294000) { *(.romx.bank165*) . = ALIGN(2); } > ROMX
    .romx.bank166 0x4000 : AT(0x298000) { *(.romx.bank166*) . = ALIGN(2); } > ROMX
    .romx.bank167 0x4000 : AT(0x29C000) { *(.romx.bank167*) . = ALIGN(2); } > ROMX
    .romx.bank168 0x4000 : AT(0x2A0000) { *(.romx.bank168*) . = ALIGN(2); } > ROMX
    .romx.bank169 0x4000 : AT(0x2A4000) { *(.romx.bank169*) . = ALIGN(2); } > ROMX
    .romx.bank170 0x4000 : AT(0x2A8000) { *(.romx.bank170*) . = ALIGN(2); } > ROMX
    .romx.bank171 0x4000 : AT(0x2AC000) { *(.romx.bank171*) . = ALIGN(2); } > ROMX
    .romx.bank172 0x4000 : AT(0x2B0000) { *(.romx.bank172*) . = ALIGN(2); } > ROMX
    .romx.bank173 0x4000 : AT(0x2B4000) { *(.romx.bank173*) . = ALIGN(2); } > ROMX
    .romx.bank174 0x4000 : AT(0x2B8000) { *(.romx.bank174*) . = ALIGN(2); } > ROMX
    .romx.bank175 0x4000 : AT(0x2BC000) { *(.romx.bank175*) . = ALIGN(2); } > ROMX
    .romx.bank176 0x4000 : AT(0x2C0000) { *(.romx.bank176*) . = ALIGN(2); } > ROMX
    .romx.bank177 0x4000 : AT(0x2C4000) { *(.romx.bank177*) . = ALIGN(2); } > ROMX
    .romx.bank178 0x4000 : AT(0x2C8000) { *(.romx.bank178*) . = ALIGN(2); } > ROMX
    .romx.bank179 0x4000 : AT(0x2CC000) { *(.romx.bank179*) . = ALIGN(2); } > ROMX
    .romx.bank180 0x4000 : AT(0x2D0000) { *(.romx.bank180*) . = ALIGN(2); } > ROMX
    .romx.bank181 0x4000 : AT(0x2D4000) { *(.romx.bank181*) . = ALIGN(2); } > ROMX
    .romx.bank182 0x4000 : AT(0x2D8000) { *(.romx.bank182*) . = ALIGN(2); } > ROMX
    .romx.bank183 0x4000 : AT(0x2DC000) { *(.romx.bank183*) . = ALIGN(2); } > ROMX
    .romx.bank184 0x4000 : AT(0x2E0000) { *(.romx.bank184*) . = ALIGN(2); } > ROMX
    .romx.bank185 0x4000 : AT(0x2E4000) { *(.romx.bank185*) . = ALIGN(2); } > ROMX
    .romx.bank186 0x4000 : AT(0x2E8000) { *(.romx.bank186*) . = ALIGN(2); } > ROMX
    .romx.bank187 0x4000 : AT(0x2EC000) { *(.romx.bank187*) . = ALIGN(2); } > ROMX
    .romx.bank188 0x4000 : AT(0x2F0000) { *(.romx.bank188*) . = ALIGN(2); } > ROMX
    .romx.bank189 0x4000 : AT(0x2F4000) { *(.romx.bank189*) . = ALIGN(2); } > ROMX
    .romx.bank190 0x4000 : AT(0x2F8000) { *(.romx.bank190*) . = ALIGN(2); } > ROMX
    .romx.bank191 0x4000 : AT(0x2FC000) { *(.romx.bank191*) . = ALIGN(2); } > ROMX
    .romx.bank192 0x4000 : AT(0x300000) { *(.romx.bank192*) . = ALIGN(2); } > ROMX
    .romx.bank193 0x4000 : AT(0x304000) { *(.romx.bank193*) . = ALIGN(2); } > ROMX
    .romx.bank194 0x4000 : AT(0x308000) { *(.romx.bank194*) . = ALIGN(2); } > ROMX
    .romx.bank195 0x4000 : AT(0x30C000) { *(.romx.bank195*) . = ALIGN(2); } > ROMX
    .romx.bank196 0x4000 : AT(0x310000) { *(.romx.bank196*) . = ALIGN(2); } > ROMX
    .romx.bank197 0x4000 : AT(0x314000) { *(.romx.bank197*) . = ALIGN(2); } > ROMX
    .romx.bank198 0x4000 : AT(0x318000) { *(.romx.bank198*) . = ALIGN(2); } > ROMX
    .romx.bank199 0x4000 : AT(0x31C000) { *(.romx.bank199*) . = ALIGN(2); } > ROMX
    .romx.bank200 0x4000 : AT(0x320000) { *(.romx.bank200*) . = ALIGN(2); } > ROMX
    .romx.bank201 0x4000 : AT(0x324000) { *(.romx.bank201*) . = ALIGN(2); } > ROMX
    .romx.bank202 0x4000 : AT(0x328000) { *(.romx.bank202*) . = ALIGN(2); } > ROMX
    .romx.bank203 0x4000 : AT(0x32C000) { *(.romx.bank203*) . = ALIGN(2); } > ROMX
    .romx.bank204 0x4000 : AT(0x330000) { *(.romx.bank204*) . = ALIGN(2); } > ROMX
    .romx.bank205 0x4000 : AT(0x334000) { *(.romx.bank205*) . = ALIGN(2); } > ROMX
    .romx.bank206 0x4000 : AT(0x338000) { *(.romx.bank206*) . = ALIGN(2); } > ROMX
    .romx.bank207 0x4000 : AT(0x33C000) { *(.romx.bank207*) . = ALIGN(2); } > ROMX
    .romx.bank208 0x4000 : AT(0x340000) { *(.romx.bank208*) . = ALIGN(2); } > ROMX
    .romx.bank209 0x4000 : AT(0x344000) { *(.romx.bank209*) . = ALIGN(2); } > ROMX
    .romx.bank210 0x4000 : AT(0x348000) { *(.romx.bank210*) . = ALIGN(2); } > ROMX
    .romx.bank211 0x4000 : AT(0x34C000) { *(.romx.bank211*) . = ALIGN(2); } > ROMX
    .romx.bank212 0x4000 : AT(0x350000) { *(.romx.bank212*) . = ALIGN(2); } > ROMX
    .romx.bank213 0x4000 : AT(0x354000) { *(.romx.bank213*) . = ALIGN(2); } > ROMX
    .romx.bank214 0x4000 : AT(0x358000) { *(.romx.bank214*) . = ALIGN(2); } > ROMX
    .romx.bank215 0x4000 : AT(0x35C000) { *(.romx.bank215*) . = ALIGN(2); } > ROMX
    .romx.bank216 0x4000 : AT(0x360000) { *(.romx.bank216*) . = ALIGN(2); } > ROMX
    .romx.bank217 0x4000 : AT(0x364000) { *(.romx.bank217*) . = ALIGN(2); } > ROMX
    .romx.bank218 0x4000 : AT(0x368000) { *(.romx.bank218*) . = ALIGN(2); } > ROMX
    .romx.bank219 0x4000 : AT(0x36C000) { *(.romx.bank219*) . = ALIGN(2); } > ROMX
    .romx.bank220 0x4000 : AT(0x370000) { *(.romx.bank220*) . = ALIGN(2); } > ROMX
    .romx.bank221 0x4000 : AT(0x374000) { *(.romx.bank221*) . = ALIGN(2); } > ROMX
    .romx.bank222 0x4000 : AT(0x378000) { *(.romx.bank222*) . = ALIGN(2); } > ROMX
    .romx.bank223 0x4000 : AT(0x37C000) { *(.romx.bank223*) . = ALIGN(2); } > ROMX
    .romx.bank224 0x4000 : AT(0x380000) { *(.romx.bank224*) . = ALIGN(2); } > ROMX
    .romx.bank225 0x4000 : AT(0x384000) { *(.romx.bank225*) . = ALIGN(2); } > ROMX
    .romx.bank226 0x4000 : AT(0x388000) { *(.romx.bank226*) . = ALIGN(2); } > ROMX
    .romx.bank227 0x4000 : AT(0x38C000) { *(.romx.bank227*) . = ALIGN(2); } > ROMX
    .romx.bank228 0x4000 : AT(0x390000) { *(.romx.bank228*) . = ALIGN(2); } > ROMX
    .romx.bank229 0x4000 : AT(0x394000) { *(.romx.bank229*) . = ALIGN(2); } > ROMX
    .romx.bank230 0x4000 : AT(0x398000) { *(.romx.bank230*) . = ALIGN(2); } > ROMX
    .romx.bank231 0x4000 : AT(0x39C000) { *(.romx.bank231*) . = ALIGN(2); } > ROMX
    .romx.bank232 0x4000 : AT(0x3A0000) { *(.romx.bank232*) . = ALIGN(2); } > ROMX
    .romx.bank233 0x4000 : AT(0x3A4000) { *(.romx.bank233*) . = ALIGN(2); } > ROMX
    .romx.bank234 0x4000 : AT(0x3A8000) { *(.romx.bank234*) . = ALIGN(2); } > ROMX
    .romx.bank235 0x4000 : AT(0x3AC000) { *(.romx.bank235*) . = ALIGN(2); } > ROMX
    .romx.bank236 0x4000 : AT(0x3B0000) { *(.romx.bank236*) . = ALIGN(2); } > ROMX
    .romx.bank237 0x4000 : AT(0x3B4000) { *(.romx.bank237*) . = ALIGN(2); } > ROMX
    .romx.bank238 0x4000 : AT(0x3B8000) { *(.romx.bank238*) . = ALIGN(2); } > ROMX
    .romx.bank239 0x4000 : AT(0x3BC000) { *(.romx.bank239*) . = ALIGN(2); } > ROMX
    .romx.bank240 0x4000 : AT(0x3C0000) { *(.romx.bank240*) . = ALIGN(2); } > ROMX
    .romx.bank241 0x4000 : AT(0x3C4000) { *(.romx.bank241*) . = ALIGN(2); } > ROMX
    .romx.bank242 0x4000 : AT(0x3C8000) { *(.romx.bank242*) . = ALIGN(2); } > ROMX
    .romx.bank243 0x4000 : AT(0x3CC000) { *(.romx.bank243*) . = ALIGN(2); } > ROMX
    .romx.bank244 0x4000 : AT(0x3D0000) { *(.romx.bank244*) . = ALIGN(2); } > ROMX
    .romx.bank245 0x4000 : AT(0x3D4000) { *(.romx.bank245*) . = ALIGN(2); } > ROMX
    .romx.bank246 0x4000 : AT(0x3D8000) { *(.romx.bank246*) . = ALIGN(2); } > ROMX
    .romx.bank247 0x4000 : AT(0x3DC000) { *(.romx.bank247*) . = ALIGN(2); } > ROMX
    .romx.bank248 0x4000 : AT(0x3E0000) { *(.romx.bank248*) . = ALIGN(2); } > ROMX
    .romx.bank249 0x4000 : AT(0x3E4000) { *(.romx.bank249*) . = ALIGN(2); } > ROMX
    .romx.bank250 0x4000 : AT(0x3E8000) { *(.romx.bank250*) . = ALIGN(2); } > ROMX
    .romx.bank251 0x4000 : AT(0x3EC000) { *(.romx.bank251*) . = ALIGN(2); } > ROMX
    .romx.bank252 0x4000 : AT(0x3F0000) { *(.romx.bank252*) . = ALIGN(2); } > ROMX
    .romx.bank253 0x4000 : AT(0x3F4000) { *(.romx.bank253*) . = ALIGN(2); } > ROMX
    .romx.bank254 0x4000 : AT(0x3F8000) { *(.romx.bank254*) . = ALIGN(2); } > ROMX
    .romx.bank255 0x4000 : AT(0x3FC000) { *(.romx.bank255*) . = ALIGN(2); } > ROMX
    .romx.bank256 0x4000 : AT(0x400000) { *(.romx.bank256*) . = ALIGN(2); } > ROMX
    .romx.bank257 0x4000 : AT(0x404000) { *(.romx.bank257*) . = ALIGN(2); } > ROMX
    .romx.bank258 0x4000 : AT(0x408000) { *(.romx.bank258*) . = ALIGN(2); } > ROMX
    .romx.bank259 0x4000 : AT(0x40C000) { *(.romx.bank259*) . = ALIGN(2); } > ROMX
    .romx.bank260 0x4000 : AT(0x410000) { *(.romx.bank260*) . = ALIGN(2); } > ROMX
    .romx.bank261 0x4000 : AT(0x414000) { *(.romx.bank261*) . = ALIGN(2); } > ROMX
    .romx.bank262 0x4000 : AT(0x418000) { *(.romx.bank262*) . = ALIGN(2); } > ROMX
    .romx.bank263 0x4000 : AT(0x41C000) { *(.romx.bank263*) . = ALIGN(2); } > ROMX
    .romx.bank264 0x4000 : AT(0x420000) { *(.romx.bank264*) . = ALIGN(2); } > ROMX
    .romx.bank265 0x4000 : AT(0x424000) { *(.romx.bank265*) . = ALIGN(2); } > ROMX
    .romx.bank266 0x4000 : AT(0x428000) { *(.romx.bank266*) . = ALIGN(2); } > ROMX
    .romx.bank267 0x4000 : AT(0x42C000) { *(.romx.bank267*) . = ALIGN(2); } > ROMX
    .romx.bank268 0x4000 : AT(0x430000) { *(.romx.bank268*) . = ALIGN(2); } > ROMX
    .romx.bank269 0x4000 : AT(0x434000) { *(.romx.bank269*) . = ALIGN(2); } > ROMX
    .romx.bank270 0x4000 : AT(0x438000) { *(.romx.bank270*) . = ALIGN(2); } > ROMX
    .romx.bank271 0x4000 : AT(0x43C000) { *(.romx.bank271*) . = ALIGN(2); } > ROMX
    .romx.bank272 0x4000 : AT(0x440000) { *(.romx.bank272*) . = ALIGN(2); } > ROMX
    .romx.bank273 0x4000 : AT(0x444000) { *(.romx.bank273*) . = ALIGN(2); } > ROMX
    .romx.bank274 0x4000 : AT(0x448000) { *(.romx.bank274*) . = ALIGN(2); } > ROMX
    .romx.bank275 0x4000 : AT(0x44C000) { *(.romx.bank275*) . = ALIGN(2); } > ROMX
    .romx.bank276 0x4000 : AT(0x450000) { *(.romx.bank276*) . = ALIGN(2); } > ROMX
    .romx.bank277 0x4000 : AT(0x454000) { *(.romx.bank277*) . = ALIGN(2); } > ROMX
    .romx.bank278 0x4000 : AT(0x458000) { *(.romx.bank278*) . = ALIGN(2); } > ROMX
    .romx.bank279 0x4000 : AT(0x45C000) { *(.romx.bank279*) . = ALIGN(2); } > ROMX
    .romx.bank280 0x4000 : AT(0x460000) { *(.romx.bank280*) . = ALIGN(2); } > ROMX
    .romx.bank281 0x4000 : AT(0x464000) { *(.romx.bank281*) . = ALIGN(2); } > ROMX
    .romx.bank282 0x4000 : AT(0x468000) { *(.romx.bank282*) . = ALIGN(2); } > ROMX
    .romx.bank283 0x4000 : AT(0x46C000) { *(.romx.bank283*) . = ALIGN(2); } > ROMX
    .romx.bank284 0x4000 : AT(0x470000) { *(.romx.bank284*) . = ALIGN(2); } > ROMX
    .romx.bank285 0x4000 : AT(0x474000) { *(.romx.bank285*) . = ALIGN(2); } > ROMX
    .romx.bank286 0x4000 : AT(0x478000) { *(.romx.bank286*) . = ALIGN(2); } > ROMX
    .romx.bank287 0x4000 : AT(0x47C000) { *(.romx.bank287*) . = ALIGN(2); } > ROMX
    .romx.bank288 0x4000 : AT(0x480000) { *(.romx.bank288*) . = ALIGN(2); } > ROMX
    .romx.bank289 0x4000 : AT(0x484000) { *(.romx.bank289*) . = ALIGN(2); } > ROMX
    .romx.bank290 0x4000 : AT(0x488000) { *(.romx.bank290*) . = ALIGN(2); } > ROMX
    .romx.bank291 0x4000 : AT(0x48C000) { *(.romx.bank291*) . = ALIGN(2); } > ROMX
    .romx.bank292 0x4000 : AT(0x490000) { *(.romx.bank292*) . = ALIGN(2); } > ROMX
    .romx.bank293 0x4000 : AT(0x494000) { *(.romx.bank293*) . = ALIGN(2); } > ROMX
    .romx.bank294 0x4000 : AT(0x498000) { *(.romx.bank294*) . = ALIGN(2); } > ROMX
    .romx.bank295 0x4000 : AT(0x49C000) { *(.romx.bank295*) . = ALIGN(2); } > ROMX
    .romx.bank296 0x4000 : AT(0x4A0000) { *(.romx.bank296*) . = ALIGN(2); } > ROMX
    .romx.bank297 0x4000 : AT(0x4A4000) { *(.romx.bank297*) . = ALIGN(2); } > ROMX
    .romx.bank298 0x4000 : AT(0x4A8000) { *(.romx.bank298*) . = ALIGN(2); } > ROMX
    .romx.bank299 0x4000 : AT(0x4AC000) { *(.romx.bank299*) . = ALIGN(2); } > ROMX
    .romx.bank300 0x4000 : AT(0x4B0000) { *(.romx.bank300*) . = ALIGN(2); } > ROMX
    .romx.bank301 0x4000 : AT(0x4B4000) { *(.romx.bank301*) . = ALIGN(2); } > ROMX
    .romx.bank302 0x4000 : AT(0x4B8000) { *(.romx.bank302*) . = ALIGN(2); } > ROMX
    .romx.bank303 0x4000 : AT(0x4BC000) { *(.romx.bank303*) . = ALIGN(2); } > ROMX
    .romx.bank304 0x4000 : AT(0x4C0000) { *(.romx.bank304*) . = ALIGN(2); } > ROMX
    .romx.bank305 0x4000 : AT(0x4C4000) { *(.romx.bank305*) . = ALIGN(2); } > ROMX
    .romx.bank306 0x4000 : AT(0x4C8000) { *(.romx.bank306*) . = ALIGN(2); } > ROMX
    .romx.bank307 0x4000 : AT(0x4CC000) { *(.romx.bank307*) . = ALIGN(2); } > ROMX
    .romx.bank308 0x4000 : AT(0x4D0000) { *(.romx.bank308*) . = ALIGN(2); } > ROMX
    .romx.bank309 0x4000 : AT(0x4D4000) { *(.romx.bank309*) . = ALIGN(2); } > ROMX
    .romx.bank310 0x4000 : AT(0x4D8000) { *(.romx.bank310*) . = ALIGN(2); } > ROMX
    .romx.bank311 0x4000 : AT(0x4DC000) { *(.romx.bank311*) . = ALIGN(2); } > ROMX
    .romx.bank312 0x4000 : AT(0x4E0000) { *(.romx.bank312*) . = ALIGN(2); } > ROMX
    .romx.bank313 0x4000 : AT(0x4E4000) { *(.romx.bank313*) . = ALIGN(2); } > ROMX
    .romx.bank314 0x4000 : AT(0x4E8000) { *(.romx.bank314*) . = ALIGN(2); } > ROMX
    .romx.bank315 0x4000 : AT(0x4EC000) { *(.romx.bank315*) . = ALIGN(2); } > ROMX
    .romx.bank316 0x4000 : AT(0x4F0000) { *(.romx.bank316*) . = ALIGN(2); } > ROMX
    .romx.bank317 0x4000 : AT(0x4F4000) { *(.romx.bank317*) . = ALIGN(2); } > ROMX
    .romx.bank318 0x4000 : AT(0x4F8000) { *(.romx.bank318*) . = ALIGN(2); } > ROMX
    .romx.bank319 0x4000 : AT(0x4FC000) { *(.romx.bank319*) . = ALIGN(2); } > ROMX
    .romx.bank320 0x4000 : AT(0x500000) { *(.romx.bank320*) . = ALIGN(2); } > ROMX
    .romx.bank321 0x4000 : AT(0x504000) { *(.romx.bank321*) . = ALIGN(2); } > ROMX
    .romx.bank322 0x4000 : AT(0x508000) { *(.romx.bank322*) . = ALIGN(2); } > ROMX
    .romx.bank323 0x4000 : AT(0x50C000) { *(.romx.bank323*) . = ALIGN(2); } > ROMX
    .romx.bank324 0x4000 : AT(0x510000) { *(.romx.bank324*) . = ALIGN(2); } > ROMX
    .romx.bank325 0x4000 : AT(0x514000) { *(.romx.bank325*) . = ALIGN(2); } > ROMX
    .romx.bank326 0x4000 : AT(0x518000) { *(.romx.bank326*) . = ALIGN(2); } > ROMX
    .romx.bank327 0x4000 : AT(0x51C000) { *(.romx.bank327*) . = ALIGN(2); } > ROMX
    .romx.bank328 0x4000 : AT(0x520000) { *(.romx.bank328*) . = ALIGN(2); } > ROMX
    .romx.bank329 0x4000 : AT(0x524000) { *(.romx.bank329*) . = ALIGN(2); } > ROMX
    .romx.bank330 0x4000 : AT(0x528000) { *(.romx.bank330*) . = ALIGN(2); } > ROMX
    .romx.bank331 0x4000 : AT(0x52C000) { *(.romx.bank331*) . = ALIGN(2); } > ROMX
    .romx.bank332 0x4000 : AT(0x530000) { *(.romx.bank332*) . = ALIGN(2); } > ROMX
    .romx.bank333 0x4000 : AT(0x534000) { *(.romx.bank333*) . = ALIGN(2); } > ROMX
    .romx.bank334 0x4000 : AT(0x538000) { *(.romx.bank334*) . = ALIGN(2); } > ROMX
    .romx.bank335 0x4000 : AT(0x53C000) { *(.romx.bank335*) . = ALIGN(2); } > ROMX
    .romx.bank336 0x4000 : AT(0x540000) { *(.romx.bank336*) . = ALIGN(2); } > ROMX
    .romx.bank337 0x4000 : AT(0x544000) { *(.romx.bank337*) . = ALIGN(2); } > ROMX
    .romx.bank338 0x4000 : AT(0x548000) { *(.romx.bank338*) . = ALIGN(2); } > ROMX
    .romx.bank339 0x4000 : AT(0x54C000) { *(.romx.bank339*) . = ALIGN(2); } > ROMX
    .romx.bank340 0x4000 : AT(0x550000) { *(.romx.bank340*) . = ALIGN(2); } > ROMX
    .romx.bank341 0x4000 : AT(0x554000) { *(.romx.bank341*) . = ALIGN(2); } > ROMX
    .romx.bank342 0x4000 : AT(0x558000) { *(.romx.bank342*) . = ALIGN(2); } > ROMX
    .romx.bank343 0x4000 : AT(0x55C000) { *(.romx.bank343*) . = ALIGN(2); } > ROMX
    .romx.bank344 0x4000 : AT(0x560000) { *(.romx.bank344*) . = ALIGN(2); } > ROMX
    .romx.bank345 0x4000 : AT(0x564000) { *(.romx.bank345*) . = ALIGN(2); } > ROMX
    .romx.bank346 0x4000 : AT(0x568000) { *(.romx.bank346*) . = ALIGN(2); } > ROMX
    .romx.bank347 0x4000 : AT(0x56C000) { *(.romx.bank347*) . = ALIGN(2); } > ROMX
    .romx.bank348 0x4000 : AT(0x570000) { *(.romx.bank348*) . = ALIGN(2); } > ROMX
    .romx.bank349 0x4000 : AT(0x574000) { *(.romx.bank349*) . = ALIGN(2); } > ROMX
    .romx.bank350 0x4000 : AT(0x578000) { *(.romx.bank350*) . = ALIGN(2); } > ROMX
    .romx.bank351 0x4000 : AT(0x57C000) { *(.romx.bank351*) . = ALIGN(2); } > ROMX
    .romx.bank352 0x4000 : AT(0x580000) { *(.romx.bank352*) . = ALIGN(2); } > ROMX
    .romx.bank353 0x4000 : AT(0x584000) { *(.romx.bank353*) . = ALIGN(2); } > ROMX
    .romx.bank354 0x4000 : AT(0x588000) { *(.romx.bank354*) . = ALIGN(2); } > ROMX
    .romx.bank355 0x4000 : AT(0x58C000) { *(.romx.bank355*) . = ALIGN(2); } > ROMX
    .romx.bank356 0x4000 : AT(0x590000) { *(.romx.bank356*) . = ALIGN(2); } > ROMX
    .romx.bank357 0x4000 : AT(0x594000) { *(.romx.bank357*) . = ALIGN(2); } > ROMX
    .romx.bank358 0x4000 : AT(0x598000) { *(.romx.bank358*) . = ALIGN(2); } > ROMX
    .romx.bank359 0x4000 : AT(0x59C000) { *(.romx.bank359*) . = ALIGN(2); } > ROMX
    .romx.bank360 0x4000 : AT(0x5A0000) { *(.romx.bank360*) . = ALIGN(2); } > ROMX
    .romx.bank361 0x4000 : AT(0x5A4000) { *(.romx.bank361*) . = ALIGN(2); } > ROMX
    .romx.bank362 0x4000 : AT(0x5A8000) { *(.romx.bank362*) . = ALIGN(2); } > ROMX
    .romx.bank363 0x4000 : AT(0x5AC000) { *(.romx.bank363*) . = ALIGN(2); } > ROMX
    .romx.bank364 0x4000 : AT(0x5B0000) { *(.romx.bank364*) . = ALIGN(2); } > ROMX
    .romx.bank365 0x4000 : AT(0x5B4000) { *(.romx.bank365*) . = ALIGN(2); } > ROMX
    .romx.bank366 0x4000 : AT(0x5B8000) { *(.romx.bank366*) . = ALIGN(2); } > ROMX
    .romx.bank367 0x4000 : AT(0x5BC000) { *(.romx.bank367*) . = ALIGN(2); } > ROMX
    .romx.bank368 0x4000 : AT(0x5C0000) { *(.romx.bank368*) . = ALIGN(2); } > ROMX
    .romx.bank369 0x4000 : AT(0x5C4000) { *(.romx.bank369*) . = ALIGN(2); } > ROMX
    .romx.bank370 0x4000 : AT(0x5C8000) { *(.romx.bank370*) . = ALIGN(2); } > ROMX
    .romx.bank371 0x4000 : AT(0x5CC000) { *(.romx.bank371*) . = ALIGN(2); } > ROMX
    .romx.bank372 0x4000 : AT(0x5D0000) { *(.romx.bank372*) . = ALIGN(2); } > ROMX
    .romx.bank373 0x4000 : AT(0x5D4000) { *(.romx.bank373*) . = ALIGN(2); } > ROMX
    .romx.bank374 0x4000 : AT(0x5D8000) { *(.romx.bank374*) . = ALIGN(2); } > ROMX
    .romx.bank375 0x4000 : AT(0x5DC000) { *(.romx.bank375*) . = ALIGN(2); } > ROMX
    .romx.bank376 0x4000 : AT(0x5E0000) { *(.romx.bank376*) . = ALIGN(2); } > ROMX
    .romx.bank377 0x4000 : AT(0x5E4000) { *(.romx.bank377*) . = ALIGN(2); } > ROMX
    .romx.bank378 0x4000 : AT(0x5E8000) { *(.romx.bank378*) . = ALIGN(2); } > ROMX
    .romx.bank379 0x4000 : AT(0x5EC000) { *(.romx.bank379*) . = ALIGN(2); } > ROMX
    .romx.bank380 0x4000 : AT(0x5F0000) { *(.romx.bank380*) . = ALIGN(2); } > ROMX
    .romx.bank381 0x4000 : AT(0x5F4000) { *(.romx.bank381*) . = ALIGN(2); } > ROMX
    .romx.bank382 0x4000 : AT(0x5F8000) { *(.romx.bank382*) . = ALIGN(2); } > ROMX
    .romx.bank383 0x4000 : AT(0x5FC000) { *(.romx.bank383*) . = ALIGN(2); } > ROMX
    .romx.bank384 0x4000 : AT(0x600000) { *(.romx.bank384*) . = ALIGN(2); } > ROMX
    .romx.bank385 0x4000 : AT(0x604000) { *(.romx.bank385*) . = ALIGN(2); } > ROMX
    .romx.bank386 0x4000 : AT(0x608000) { *(.romx.bank386*) . = ALIGN(2); } > ROMX
    .romx.bank387 0x4000 : AT(0x60C000) { *(.romx.bank387*) . = ALIGN(2); } > ROMX
    .romx.bank388 0x4000 : AT(0x610000) { *(.romx.bank388*) . = ALIGN(2); } > ROMX
    .romx.bank389 0x4000 : AT(0x614000) { *(.romx.bank389*) . = ALIGN(2); } > ROMX
    .romx.bank390 0x4000 : AT(0x618000) { *(.romx.bank390*) . = ALIGN(2); } > ROMX
    .romx.bank391 0x4000 : AT(0x61C000) { *(.romx.bank391*) . = ALIGN(2); } > ROMX
    .romx.bank392 0x4000 : AT(0x620000) { *(.romx.bank392*) . = ALIGN(2); } > ROMX
    .romx.bank393 0x4000 : AT(0x624000) { *(.romx.bank393*) . = ALIGN(2); } > ROMX
    .romx.bank394 0x4000 : AT(0x628000) { *(.romx.bank394*) . = ALIGN(2); } > ROMX
    .romx.bank395 0x4000 : AT(0x62C000) { *(.romx.bank395*) . = ALIGN(2); } > ROMX
    .romx.bank396 0x4000 : AT(0x630000) { *(.romx.bank396*) . = ALIGN(2); } > ROMX
    .romx.bank397 0x4000 : AT(0x634000) { *(.romx.bank397*) . = ALIGN(2); } > ROMX
    .romx.bank398 0x4000 : AT(0x638000) { *(.romx.bank398*) . = ALIGN(2); } > ROMX
    .romx.bank399 0x4000 : AT(0x63C000) { *(.romx.bank399*) . = ALIGN(2); } > ROMX
    .romx.bank400 0x4000 : AT(0x640000) { *(.romx.bank400*) . = ALIGN(2); } > ROMX
    .romx.bank401 0x4000 : AT(0x644000) { *(.romx.bank401*) . = ALIGN(2); } > ROMX
    .romx.bank402 0x4000 : AT(0x648000) { *(.romx.bank402*) . = ALIGN(2); } > ROMX
    .romx.bank403 0x4000 : AT(0x64C000) { *(.romx.bank403*) . = ALIGN(2); } > ROMX
    .romx.bank404 0x4000 : AT(0x650000) { *(.romx.bank404*) . = ALIGN(2); } > ROMX
    .romx.bank405 0x4000 : AT(0x654000) { *(.romx.bank405*) . = ALIGN(2); } > ROMX
    .romx.bank406 0x4000 : AT(0x658000) { *(.romx.bank406*) . = ALIGN(2); } > ROMX
    .romx.bank407 0x4000 : AT(0x65C000) { *(.romx.bank407*) . = ALIGN(2); } > ROMX
    .romx.bank408 0x4000 : AT(0x660000) { *(.romx.bank408*) . = ALIGN(2); } > ROMX
    .romx.bank409 0x4000 : AT(0x664000) { *(.romx.bank409*) . = ALIGN(2); } > ROMX
    .romx.bank410 0x4000 : AT(0x668000) { *(.romx.bank410*) . = ALIGN(2); } > ROMX
    .romx.bank411 0x4000 : AT(0x66C000) { *(.romx.bank411*) . = ALIGN(2); } > ROMX
    .romx.bank412 0x4000 : AT(0x670000) { *(.romx.bank412*) . = ALIGN(2); } > ROMX
    .romx.bank413 0x4000 : AT(0x674000) { *(.romx.bank413*) . = ALIGN(2); } > ROMX
    .romx.bank414 0x4000 : AT(0x678000) { *(.romx.bank414*) . = ALIGN(2); } > ROMX
    .romx.bank415 0x4000 : AT(0x67C000) { *(.romx.bank415*) . = ALIGN(2); } > ROMX
    .romx.bank416 0x4000 : AT(0x680000) { *(.romx.bank416*) . = ALIGN(2); } > ROMX
    .romx.bank417 0x4000 : AT(0x684000) { *(.romx.bank417*) . = ALIGN(2); } > ROMX
    .romx.bank418 0x4000 : AT(0x688000) { *(.romx.bank418*) . = ALIGN(2); } > ROMX
    .romx.bank419 0x4000 : AT(0x68C000) { *(.romx.bank419*) . = ALIGN(2); } > ROMX
    .romx.bank420 0x4000 : AT(0x690000) { *(.romx.bank420*) . = ALIGN(2); } > ROMX
    .romx.bank421 0x4000 : AT(0x694000) { *(.romx.bank421*) . = ALIGN(2); } > ROMX
    .romx.bank422 0x4000 : AT(0x698000) { *(.romx.bank422*) . = ALIGN(2); } > ROMX
    .romx.bank423 0x4000 : AT(0x69C000) { *(.romx.bank423*) . = ALIGN(2); } > ROMX
    .romx.bank424 0x4000 : AT(0x6A0000) { *(.romx.bank424*) . = ALIGN(2); } > ROMX
    .romx.bank425 0x4000 : AT(0x6A4000) { *(.romx.bank425*) . = ALIGN(2); } > ROMX
    .romx.bank426 0x4000 : AT(0x6A8000) { *(.romx.bank426*) . = ALIGN(2); } > ROMX
    .romx.bank427 0x4000 : AT(0x6AC000) { *(.romx.bank427*) . = ALIGN(2); } > ROMX
    .romx.bank428 0x4000 : AT(0x6B0000) { *(.romx.bank428*) . = ALIGN(2); } > ROMX
    .romx.bank429 0x4000 : AT(0x6B4000) { *(.romx.bank429*) . = ALIGN(2); } > ROMX
    .romx.bank430 0x4000 : AT(0x6B8000) { *(.romx.bank430*) . = ALIGN(2); } > ROMX
    .romx.bank431 0x4000 : AT(0x6BC000) { *(.romx.bank431*) . = ALIGN(2); } > ROMX
    .romx.bank432 0x4000 : AT(0x6C0000) { *(.romx.bank432*) . = ALIGN(2); } > ROMX
    .romx.bank433 0x4000 : AT(0x6C4000) { *(.romx.bank433*) . = ALIGN(2); } > ROMX
    .romx.bank434 0x4000 : AT(0x6C8000) { *(.romx.bank434*) . = ALIGN(2); } > ROMX
    .romx.bank435 0x4000 : AT(0x6CC000) { *(.romx.bank435*) . = ALIGN(2); } > ROMX
    .romx.bank436 0x4000 : AT(0x6D0000) { *(.romx.bank436*) . = ALIGN(2); } > ROMX
    .romx.bank437 0x4000 : AT(0x6D4000) { *(.romx.bank437*) . = ALIGN(2); } > ROMX
    .romx.bank438 0x4000 : AT(0x6D8000) { *(.romx.bank438*) . = ALIGN(2); } > ROMX
    .romx.bank439 0x4000 : AT(0x6DC000) { *(.romx.bank439*) . = ALIGN(2); } > ROMX
    .romx.bank440 0x4000 : AT(0x6E0000) { *(.romx.bank440*) . = ALIGN(2); } > ROMX
    .romx.bank441 0x4000 : AT(0x6E4000) { *(.romx.bank441*) . = ALIGN(2); } > ROMX
    .romx.bank442 0x4000 : AT(0x6E8000) { *(.romx.bank442*) . = ALIGN(2); } > ROMX
    .romx.bank443 0x4000 : AT(0x6EC000) { *(.romx.bank443*) . = ALIGN(2); } > ROMX
    .romx.bank444 0x4000 : AT(0x6F0000) { *(.romx.bank444*) . = ALIGN(2); } > ROMX
    .romx.bank445 0x4000 : AT(0x6F4000) { *(.romx.bank445*) . = ALIGN(2); } > ROMX
    .romx.bank446 0x4000 : AT(0x6F8000) { *(.romx.bank446*) . = ALIGN(2); } > ROMX
    .romx.bank447 0x4000 : AT(0x6FC000) { *(.romx.bank447*) . = ALIGN(2); } > ROMX
    .romx.bank448 0x4000 : AT(0x700000) { *(.romx.bank448*) . = ALIGN(2); } > ROMX
    .romx.bank449 0x4000 : AT(0x704000) { *(.romx.bank449*) . = ALIGN(2); } > ROMX
    .romx.bank450 0x4000 : AT(0x708000) { *(.romx.bank450*) . = ALIGN(2); } > ROMX
    .romx.bank451 0x4000 : AT(0x70C000) { *(.romx.bank451*) . = ALIGN(2); } > ROMX
    .romx.bank452 0x4000 : AT(0x710000) { *(.romx.bank452*) . = ALIGN(2); } > ROMX
    .romx.bank453 0x4000 : AT(0x714000) { *(.romx.bank453*) . = ALIGN(2); } > ROMX
    .romx.bank454 0x4000 : AT(0x718000) { *(.romx.bank454*) . = ALIGN(2); } > ROMX
    .romx.bank455 0x4000 : AT(0x71C000) { *(.romx.bank455*) . = ALIGN(2); } > ROMX
    .romx.bank456 0x4000 : AT(0x720000) { *(.romx.bank456*) . = ALIGN(2); } > ROMX
    .romx.bank457 0x4000 : AT(0x724000) { *(.romx.bank457*) . = ALIGN(2); } > ROMX
    .romx.bank458 0x4000 : AT(0x728000) { *(.romx.bank458*) . = ALIGN(2); } > ROMX
    .romx.bank459 0x4000 : AT(0x72C000) { *(.romx.bank459*) . = ALIGN(2); } > ROMX
    .romx.bank460 0x4000 : AT(0x730000) { *(.romx.bank460*) . = ALIGN(2); } > ROMX
    .romx.bank461 0x4000 : AT(0x734000) { *(.romx.bank461*) . = ALIGN(2); } > ROMX
    .romx.bank462 0x4000 : AT(0x738000) { *(.romx.bank462*) . = ALIGN(2); } > ROMX
    .romx.bank463 0x4000 : AT(0x73C000) { *(.romx.bank463*) . = ALIGN(2); } > ROMX
    .romx.bank464 0x4000 : AT(0x740000) { *(.romx.bank464*) . = ALIGN(2); } > ROMX
    .romx.bank465 0x4000 : AT(0x744000) { *(.romx.bank465*) . = ALIGN(2); } > ROMX
    .romx.bank466 0x4000 : AT(0x748000) { *(.romx.bank466*) . = ALIGN(2); } > ROMX
    .romx.bank467 0x4000 : AT(0x74C000) { *(.romx.bank467*) . = ALIGN(2); } > ROMX
    .romx.bank468 0x4000 : AT(0x750000) { *(.romx.bank468*) . = ALIGN(2); } > ROMX
    .romx.bank469 0x4000 : AT(0x754000) { *(.romx.bank469*) . = ALIGN(2); } > ROMX
    .romx.bank470 0x4000 : AT(0x758000) { *(.romx.bank470*) . = ALIGN(2); } > ROMX
    .romx.bank471 0x4000 : AT(0x75C000) { *(.romx.bank471*) . = ALIGN(2); } > ROMX
    .romx.bank472 0x4000 : AT(0x760000) { *(.romx.bank472*) . = ALIGN(2); } > ROMX
    .romx.bank473 0x4000 : AT(0x764000) { *(.romx.bank473*) . = ALIGN(2); } > ROMX
    .romx.bank474 0x4000 : AT(0x768000) { *(.romx.bank474*) . = ALIGN(2); } > ROMX
    .romx.bank475 0x4000 : AT(0x76C000) { *(.romx.bank475*) . = ALIGN(2); } > ROMX
    .romx.bank476 0x4000 : AT(0x770000) { *(.romx.bank476*) . = ALIGN(2); } > ROMX
    .romx.bank477 0x4000 : AT(0x774000) { *(.romx.bank477*) . = ALIGN(2); } > ROMX
    .romx.bank478 0x4000 : AT(0x778000) { *(.romx.bank478*) . = ALIGN(2); } > ROMX
    .romx.bank479 0x4000 : AT(0x77C000) { *(.romx.bank479*) . = ALIGN(2); } > ROMX
    .romx.bank480 0x4000 : AT(0x780000) { *(.romx.bank480*) . = ALIGN(2); } > ROMX
    .romx.bank481 0x4000 : AT(0x784000) { *(.romx.bank481*) . = ALIGN(2); } > ROMX
    .romx.bank482 0x4000 : AT(0x788000) { *(.romx.bank482*) . = ALIGN(2); } > ROMX
    .romx.bank483 0x4000 : AT(0x78C000) { *(.romx.bank483*) . = ALIGN(2); } > ROMX
    .romx.bank484 0x4000 : AT(0x790000) { *(.romx.bank484*) . = ALIGN(2); } > ROMX
    .romx.bank485 0x4000 : AT(0x794000) { *(.romx.bank485*) . = ALIGN(2); } > ROMX
    .romx.bank486 0x4000 : AT(0x798000) { *(.romx.bank486*) . = ALIGN(2); } > ROMX
    .romx.bank487 0x4000 : AT(0x79C000) { *(.romx.bank487*) . = ALIGN(2); } > ROMX
    .romx.bank488 0x4000 : AT(0x7A0000) { *(.romx.bank488*) . = ALIGN(2); } > ROMX
    .romx.bank489 0x4000 : AT(0x7A4000) { *(.romx.bank489*) . = ALIGN(2); } > ROMX
    .romx.bank490 0x4000 : AT(0x7A8000) { *(.romx.bank490*) . = ALIGN(2); } > ROMX
    .romx.bank491 0x4000 : AT(0x7AC000) { *(.romx.bank491*) . = ALIGN(2); } > ROMX
    .romx.bank492 0x4000 : AT(0x7B0000) { *(.romx.bank492*) . = ALIGN(2); } > ROMX
    .romx.bank493 0x4000 : AT(0x7B4000) { *(.romx.bank493*) . = ALIGN(2); } > ROMX
    .romx.bank494 0x4000 : AT(0x7B8000) { *(.romx.bank494*) . = ALIGN(2); } > ROMX
    .romx.bank495 0x4000 : AT(0x7BC000) { *(.romx.bank495*) . = ALIGN(2); } > ROMX
    .romx.bank496 0x4000 : AT(0x7C0000) { *(.romx.bank496*) . = ALIGN(2); } > ROMX
    .romx.bank497 0x4000 : AT(0x7C4000) { *(.romx.bank497*) . = ALIGN(2); } > ROMX
    .romx.bank498 0x4000 : AT(0x7C8000) { *(.romx.bank498*) . = ALIGN(2); } > ROMX
    .romx.bank499 0x4000 : AT(0x7CC000) { *(.romx.bank499*) . = ALIGN(2); } > ROMX
    .romx.bank500 0x4000 : AT(0x7D0000) { *(.romx.bank500*) . = ALIGN(2); } > ROMX
    .romx.bank501 0x4000 : AT(0x7D4000) { *(.romx.bank501*) . = ALIGN(2); } > ROMX
    .romx.bank502 0x4000 : AT(0x7D8000) { *(.romx.bank502*) . = ALIGN(2); } > ROMX
    .romx.bank503 0x4000 : AT(0x7DC000) { *(.romx.bank503*) . = ALIGN(2); } > ROMX
    .romx.bank504 0x4000 : AT(0x7E0000) { *(.romx.bank504*) . = ALIGN(2); } > ROMX
    .romx.bank505 0x4000 : AT(0x7E4000) { *(.romx.bank505*) . = ALIGN(2); } > ROMX
    .romx.bank506 0x4000 : AT(0x7E8000) { *(.romx.bank506*) . = ALIGN(2); } > ROMX
    .romx.bank507 0x4000 : AT(0x7EC000) { *(.romx.bank507*) . = ALIGN(2); } > ROMX
    .romx.bank508 0x4000 : AT(0x7F0000) { *(.romx.bank508*) . = ALIGN(2); } > ROMX
    .romx.bank509 0x4000 : AT(0x7F4000) { *(.romx.bank509*) . = ALIGN(2); } > ROMX
    .romx.bank510 0x4000 : AT(0x7F8000) { *(.romx.bank510*) . = ALIGN(2); } > ROMX
    .romx.bank511 0x4000 : AT(0x7FC000) { *(.romx.bank511*) . = ALIGN(2); } > ROMX



    /*
     * Initialised data: VMA in WRAM, LMA appended to bank 0 in the ROM
     * file so crt0 can copy it at boot.
     */
    .data : AT(_rom0_end) {
        _data_start = .;
        *(.data*)
        . = ALIGN(2);
        _data_end = .;
    } > WRAM
    _data_load = LOADADDR(.data);

    /* .bss: LMA = VMA so ld doesn't reserve an overlapping ROM range. */
    .bss (NOLOAD) : AT(ADDR(.bss)) {
        _bss_start = .;
        *(.bss*)
        *(COMMON)
        . = ALIGN(2);
        _bss_end = .;
    } > WRAM

    PROVIDE(_stack_top = ORIGIN(WRAM) + LENGTH(WRAM) - 1);

    /*
     * HRAM — 127 bytes of fast memory at $FF80-$FFFE.
     * Code here executes during OAM DMA ($FF46 write). Contents stored in
     * ROM after .data and copied to HRAM by crt0.
     */
    .hram 0xFF80 : AT(LOADADDR(.data) + SIZEOF(.data)) {
        _hram_start = .;
        *(.hram*)
        . = ALIGN(2);
        _hram_end = .;
    } > HRAM
    _hram_load = LOADADDR(.hram);
    ASSERT(_hram_end <= 0xFFFF, "HRAM overflow: exceeds 127 bytes at $FF80")
    ASSERT(LOADADDR(.hram) + SIZEOF(.hram) <= 0x4000,
           "Bank 0 overflow: code + data + hram exceeds 16 KB")

    /* Discard debug and exception-handling sections. */
    /DISCARD/ : {
        *(.debug*)
        *(.comment*)
        *(.eh_frame*)
        *(.note*)
    }
}
